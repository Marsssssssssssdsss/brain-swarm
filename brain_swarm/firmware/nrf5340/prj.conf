## prj.conf
```kconfig
# NeuroResonator nRF5340 - Zephyr Project Configuration
#
# CPU & Power
CONFIG_SOC_NRF5340_CPUAPP=y
CONFIG_SYS_CLOCK_HW_CYCLES_PER_SEC=128000000
CONFIG_MAIN_STACK_SIZE=8192
CONFIG_ISR_STACK_SIZE=4096
CONFIG_SLEEP=y
CONFIG_PM=y
CONFIG_PM_DEVICE=y

# Bluetooth
CONFIG_BT=y
CONFIG_BT_PERIPHERAL=y
CONFIG_BT_GATT_DYNAMIC_DB=y
CONFIG_BT_DEVICE_NAME="NeuroResonator"
CONFIG_BT_MAX_CONN=1
CONFIG_BT_MAX_PAIRED=1
CONFIG_BT_RX_BUF_LEN=64
CONFIG_BT_TX_BUF_COUNT=6
CONFIG_BT_BUF_ACL_TX_SIZE=64

# SPI
CONFIG_SPI=y
CONFIG_SPI_ASYNC=y
CONFIG_SPI_DMA=y
CONFIG_SPI_NRFX=y
CONFIG_NRFX_SPIM3=y

# I2C
CONFIG_I2C=y

# ADC
CONFIG_ADC=y
CONFIG_ADC_NRFX_SAADC=y

# UART
CONFIG_UART_INTERRUPT_DRIVEN=y
CONFIG_SERIAL=y

# Sensor subsystem
CONFIG_SENSOR=y
CONFIG_SENSOR_LOG_LEVEL_WRN=y

# Storage
CONFIG_NVS=y
CONFIG_FLASH=y
CONFIG_FLASH_MAP=y
CONFIG_FCB=y

# Logging
CONFIG_LOG=y
CONFIG_LOG_LEVEL_DBG=y
CONFIG_LOG_BACKEND_UART=y
CONFIG_LOG_BACKEND_UART_SYSTREAM_ENABLE=n

# CMSIS-DSP
CONFIG_CMSIS_DSP=y

# Kernel
CONFIG_MULTITHREADING=y
CONFIG_NUM_COOP_PRIORITIES=16
CONFIG_NUM_PREEMPT_PRIORITIES=16
CONFIG_TIMESLICING=y
CONFIG_TIMESLICE_SIZE=10
CONFIG_TIMESLICE_PRIORITY=0

# Heap
CONFIG_HEAP_MEM_POOL_SIZE=4096

# GPIO
CONFIG_GPIO=y

# CRC
CONFIG_CRC=y

# Ring buffer
CONFIG_RING_BUFFER=y
```

## src/main.c
```c
/**
 * NeuroResonator — nRF5340 Sensor Domain Firmware
 *
 * Architecture:
 *   DRDY @250Hz: ADS1299 SPI DMA read -> buffer 4ch x 24bit
 *   Timer @1Hz:   Send latest EEG frame to ESP32-S3 via UART
 *   UART Rx:      Receive focus state from ESP32-S3 -> update tDCS
 *   BLE:          Notify brain state data to phone app
 *   Safety:       Continuous impedance + overcurrent monitoring
 */

#include <zephyr/kernel.h>
#include <zephyr/device.h>
#include <zephyr/drivers/gpio.h>
#include <zephyr/logging/log.h>
#include <zephyr/sys/byteorder.h>
#include <string.h>
#include <math.h>

#include "ads1299.h"
#include "ble_service.h"
#include "dac_control.h"
#include "tdcs_safety.h"
#include "uart_protocol.h"

LOG_MODULE_REGISTER(main, LOG_LEVEL_DBG);

/* =========================================================================
 * Constants
 * ========================================================================= */

#define EEG_SAMPLE_RATE_HZ     250
#define BRAIN_STATE_INTERVAL_MS 1000
#define SAFETY_CHECK_INTERVAL_MS 500
#define ADC_REF_VOLTAGE         4.5f
#define ADC_GAIN                24.0f
#define FOCUS_SCORE_THRESHOLD   60

/* EEG ring buffer depth */
#define EEG_RING_BUF_SIZE       64
#define NUM_EEG_CHANNELS        4

/* =========================================================================
 * Global state
 * ========================================================================= */

/* EEG ring buffer */
static struct ads1299_sample eeg_ring_buf[EEG_RING_BUF_SIZE];
static volatile uint16_t eeg_write_idx;
static volatile uint16_t eeg_read_idx;
static struct k_sem eeg_sem;

/* Latest complete frame for sharing */
static struct ads1299_sample latest_eeg_frame;

/* Focus state from ESP32 */
static volatile struct focus_state_payload current_focus_state;

/* Brain state for BLE */
static struct brain_state_payload brain_state;

/* Control flags */
static volatile bool stim_active;
static volatile bool system_initialized;

/* Thread IDs */
static struct k_thread eeg_thread_data;
static struct k_thread ble_thread_data;
static struct k_thread safety_thread_data;
static struct k_thread uart_rx_thread_data;

/* Stack areas */
K_THREAD_STACK_DEFINE(eeg_stack, 4096);
K_THREAD_STACK_DEFINE(ble_stack, 2048);
K_THREAD_STACK_DEFINE(safety_stack, 2048);
K_THREAD_STACK_DEFINE(uart_rx_stack, 2048);

/* Synchronization */
static struct k_sem uart_tx_sem;

/* =========================================================================
 * ADS1299 configuration
 * ========================================================================= */

static const struct ads1299_config sensor_cfg = {
    .num_channels = 4,
    .gain = {
        ADS1299_CHnSET_GAIN_24,
        ADS1299_CHnSET_GAIN_24,
        ADS1299_CHnSET_GAIN_24,
        ADS1299_CHnSET_GAIN_24,
        0, 0, 0, 0
    },
    .channel_mux = {
        ADS1299_CHnSET_MUX_NORMAL,
        ADS1299_CHnSET_MUX_NORMAL,
        ADS1299_CHnSET_MUX_NORMAL,
        ADS1299_CHnSET_MUX_NORMAL,
        0, 0, 0, 0
    },
    .sampling_rate = ADS1299_CONFIG1_DR_250SPS,
    .srb1_enabled = true,
    .bias_enabled = true,
    .lead_off_enabled = true,
};

/* =========================================================================
 * EEG processing thread
 * ========================================================================= */

static void eeg_thread(void *arg1, void *arg2, void *arg3)
{
    ARG_UNUSED(arg1);
    ARG_UNUSED(arg2);
    ARG_UNUSED(arg3);

    int ret;
    struct ads1299_sample sample;

    LOG_INF("EEG thread started");

    while (1) {
        /* Block until DRDY fires (250Hz) */
        ret = ads1299_read_data(&sample);
        if (ret < 0) {
            if (ret != -ETIMEDOUT) {
                LOG_ERR("ADS1299 read failed: %d", ret);
            }
            continue;
        }

        /* Store in ring buffer */
        uint16_t next_idx = (eeg_write_idx + 1) % EEG_RING_BUF_SIZE;
        if (next_idx != eeg_read_idx) {
            memcpy(&eeg_ring_buf[eeg_write_idx], &sample,
                   sizeof(struct ads1299_sample));
            eeg_write_idx = next_idx;
            k_sem_give(&eeg_sem);
        } else {
            LOG_WRN("EEG ring buffer full, dropping sample");
        }

        /* Update latest frame for other consumers */
        memcpy(&latest_eeg_frame, &sample, sizeof(struct ads1299_sample));
    }
}

/* =========================================================================
 * Brain state computation
 * ========================================================================= */

static void compute_brain_state(struct brain_state_payload *bs)
{
    if (!bs) return;

    int32_t ch_data[NUM_EEG_CHANNELS];

    /* Grab latest sample */
    struct ads1299_sample frame;
    memcpy(&frame, (void *)&latest_eeg_frame, sizeof(frame));

    for (int i = 0; i < NUM_EEG_CHANNELS; i++) {
        ch_data[i] = frame.channels[i];
    }

    /* Compress 24-bit to 16-bit for BLE payload */
    for (int i = 0; i < 4; i++) {
        int32_t val = ch_data[i] >> 8;
        if (val < -32768) val = -32768;
        if (val > 32767) val = 32767;
        bs->channel_data[i * 2] = (uint8_t)(val >> 8);
        bs->channel_data[i * 2 + 1] = (uint8_t)(val & 0xFF);
    }

    /* Estimate band powers using simplified amplitude approach */
    int32_t alpha_sum = 0, beta_sum = 0, theta_sum = 0, delta_sum = 0;

    for (int i = 0; i < NUM_EEG_CHANNELS; i++) {
        int32_t abs_val = abs(ch_data[i]);

        /* Simple frequency proxy based on sample-to-sample variation */
        static int32_t prev_ch[NUM_EEG_CHANNELS];
        int32_t diff = ch_data[i] - prev_ch[i];
        prev_ch[i] = ch_data[i];
        int32_t abs_diff = abs(diff);

        /* Delta (0-4Hz): large amplitude, slow change */
        delta_sum += abs_val;

        /* Theta (4-8Hz): medium amplitude */
        theta_sum += abs_val / 2;

        /* Alpha (8-13Hz): medium amplitude, moderate change */
        alpha_sum += abs_val / 3 + abs_diff;

        /* Beta (13-30Hz): smaller amplitude, faster change */
        beta_sum += abs_diff;
    }

    /* Normalize to 0-255 */
    uint32_t norm = (uint32_t)(delta_sum + theta_sum + alpha_sum + beta_sum);
    if (norm == 0) norm = 1;

    bs->delta_power = (uint8_t)((uint32_t)delta_sum * 255 / norm);
    bs->theta_power = (uint8_t)((uint32_t)theta_sum * 255 / norm);
    bs->alpha_power = (uint8_t)((uint32_t)alpha_sum * 255 / norm);
    bs->beta_power = (uint8_t)((uint32_t)beta_sum * 255 / norm);

    /* Focus score: high alpha + beta ratio indicates focus */
    uint16_t alpha_beta = bs->alpha_power + bs->beta_power;
    if (alpha_beta > 0) {
        bs->focus_score = (uint8_t)((uint32_t)bs->beta_power * 100 / alpha_beta);
        if (bs->focus_score > 100) bs->focus_score = 100;
    } else {
        bs->focus_score = 50;
    }

    bs->current_ma_x10 = (uint8_t)(fabsf(dac_get_current_ma()) * 10.0f);

    uint8_t flags = 0;
    if (stim_active) flags |= 0x01;
    if (safety_ok()) flags |= 0x02;
    bs->status_flags = flags;

    memset(bs->reserved, 0, sizeof(bs->reserved));
}

/* =========================================================================
 * BLE notification thread (1Hz)
 * ========================================================================= */

static void ble_thread(void *arg1, void *arg2, void *arg3)
{
    ARG_UNUSED(arg1);
    ARG_UNUSED(arg2);
    ARG_UNUSED(arg3);

    LOG_INF("BLE thread started");

    while (1) {
        k_sleep(K_MSEC(BRAIN_STATE_INTERVAL_MS));

        if (!system_initialized) continue;

        /* Compute brain state from latest EEG frame */
        compute_brain_state(&brain_state);

        /* Send BLE notification */
        int ret = ble_notify_brain_state(&brain_state);
        if (ret < 0 && ret != -ENOTCONN) {
            LOG_WRN("BLE notify failed: %d", ret);
        }
    }
}

/* =========================================================================
 * Safety monitoring thread
 * ========================================================================= */

static void safety_thread(void *arg1, void *arg2, void *arg3)
{
    ARG_UNUSED(arg1);
    ARG_UNUSED(arg2);
    ARG_UNUSED(arg3);

    LOG_INF("Safety thread started");

    while (1) {
        k_sleep(K_MSEC(SAFETY_CHECK_INTERVAL_MS));

        if (!system_initialized) continue;

        int ret = safety_tick();
        if (ret < 0) {
            LOG_ERR("Safety check failed, emergency stop");
            if (stim_active) {
                dac_set_current_ma(0.0f);
                stim_active = false;
            }
        }
    }
}

/* =========================================================================
 * UART RX processing thread
 * ========================================================================= */

static void on_uart_packet(uint8_t type, const uint8_t *payload, uint16_t length)
{
    switch (type) {
    case PKT_TYPE_FOCUS_STATE: {
        if (length < sizeof(struct focus_state_payload)) {
            LOG_WRN("Short focus state packet: %d bytes", length);
            break;
        }

        struct focus_state_payload *fs = (struct focus_state_payload *)payload;
        memcpy((void *)&current_focus_state, fs, sizeof(struct focus_state_payload));

        LOG_DBG("Focus: state=%d score=%d current=%d mode=%d",
                fs->state, fs->score, fs->current_ma_x10, fs->mode);

        /* Apply closed-loop control */
        if (fs->mode != STIM_MODE_OFF && fs->score > FOCUS_SCORE_THRESHOLD) {
            float target_ma = (float)fs->current_ma_x10 / 10.0f;

            /* Safety check before applying */
            float impedance;
            safety_measure_impedance(&impedance);

            if (safety_check(target_ma, impedance) == 0) {
                if (!stim_active) {
                    safety_start_session();
                    stim_active = true;
                }
                dac_ramp_up(target_ma, RAMP_RATE);

                LOG_INF("Stim ON: %.2f mA (focus=%d)", target_ma, fs->score);
            } else {
                LOG_WRN("Safety block: stim not applied");
            }
        } else {
            if (stim_active) {
                LOG_INF("Stim OFF: focus=%d below threshold", fs->score);
                dac_ramp_down(RAMP_RATE);
                safety_stop_session();
                stim_active = false;
            }
        }
        break;
    }

    case PKT_TYPE_LOG: {
        char log_buf[UART_MAX_PAYLOAD_SIZE + 1];
        uint16_t copy_len = length < UART_MAX_PAYLOAD_SIZE ? length : UART_MAX_PAYLOAD_SIZE;
        memcpy(log_buf, payload, copy_len);
        log_buf[copy_len] = '\0';
        LOG_INF("ESP32: %s", log_buf);
        break;
    }

    case PKT_TYPE_ACK: {
        LOG_DBG("ACK received");
        break;
    }

    default:
        LOG_DBG("Unknown packet type: 0x%02X", type);
        break;
    }
}

static void uart_rx_thread(void *arg1, void *arg2, void *arg3)
{
    ARG_UNUSED(arg1);
    ARG_UNUSED(arg2);
    ARG_UNUSED(arg3);

    LOG_INF("UART RX thread started");

    while (1) {
        k_sleep(K_MSEC(10));

        if (!system_initialized) continue;

        uart_process();
    }
}

/* =========================================================================
 * BLE command handler
 * ========================================================================= */

static void on_ble_command(const struct command_payload *cmd)
{
    if (!cmd) return;

    LOG_DBG("BLE cmd: 0x%02X", cmd->cmd_id);

    switch (cmd->cmd_id) {
    case CMD_ID_START_STIM: {
        if (safety_ok()) {
            float impedance;
            safety_measure_impedance(&impedance);
            if (impedance < MAX_IMPEDANCE_KOHM) {
                safety_start_session();
                stim_active = true;
                float target = (float)cmd->param1 / 10.0f;
                dac_ramp_up(target, RAMP_RATE);
                LOG_INF("Stim started from BLE: %.2f mA", target);
            } else {
                LOG_WRN("BLE stim blocked: high impedance %.1f kOhm", impedance);
            }
        }
        break;
    }

    case CMD_ID_STOP_STIM: {
        if (stim_active) {
            dac_ramp_down(RAMP_RATE);
            safety_stop_session();
            stim_active = false;
            LOG_INF("Stim stopped from BLE");
        }
        break;
    }

    case CMD_ID_SET_CURRENT: {
        float target = (float)cmd->param1 / 10.0f;
        if (target <= MAX_CURRENT_MA) {
            dac_set_current_ma(target);
            LOG_DBG("Current set to %.2f mA from BLE", target);
        }
        break;
    }

    case CMD_ID_SET_MODE: {
        LOG_INF("Mode set: %d", cmd->param1);
        break;
    }

    case CMD_ID_CALIBRATE: {
        ads1299_perform_offset_cal();
        LOG_INF("Offset calibration requested from BLE");
        break;
    }

    case CMD_ID_GET_STATUS: {
        struct brain_state_payload status;
        compute_brain_state(&status);
        ble_notify_brain_state(&status);
        break;
    }

    default:
        LOG_WRN("Unknown BLE command: 0x%02X", cmd->cmd_id);
        break;
    }
}

/* =========================================================================
 * UART periodic send (1Hz EEG data to ESP32)
 * ========================================================================= */

static void send_eeg_to_esp32(void)
{
    struct eeg_data_payload eeg_pkt;
    static uint32_t seq = 0;

    /* Grab latest EEG frame */
    struct ads1299_sample frame;
    memcpy(&frame, (void *)&latest_eeg_frame, sizeof(frame));

    /* Pack 24-bit channel data, MSB first */
    for (int ch = 0; ch < NUM_EEG_CHANNELS; ch++) {
        int32_t val = frame.channels[ch];
        uint8_t *dest;
        switch (ch) {
        case 0: dest = eeg_pkt.channel_0; break;
        case 1: dest = eeg_pkt.channel_1; break;
        case 2: dest = eeg_pkt.channel_2; break;
        default: dest = eeg_pkt.channel_3; break;
        }
        dest[0] = (uint8_t)(val >> 16);
        dest[1] = (uint8_t)(val >> 8);
        dest[2] = (uint8_t)(val & 0xFF);
    }

    eeg_pkt.seq_num = seq++;
    eeg_pkt.timestamp_ms = k_uptime_get();

    uart_send_eeg_data(&eeg_pkt);
}

/* =========================================================================
 * Main
 * ========================================================================= */

void main(void)
{
    int ret;

    LOG_INF("NeuroResonator nRF5340 Sensor Domain starting...");

    /* Initialize semaphores */
    k_sem_init(&eeg_sem, 0, EEG_RING_BUF_SIZE);
    k_sem_init(&uart_tx_sem, 0, 1);

    /* Initialize ring buffer indices */
    eeg_write_idx = 0;
    eeg_read_idx = 0;

    /* Clear state */
    memset(&latest_eeg_frame, 0, sizeof(latest_eeg_frame));
    memset(&current_focus_state, 0, sizeof(current_focus_state));
    memset(&brain_state, 0, sizeof(brain_state));
    stim_active = false;
    system_initialized = false;

    /* ---- Initialize ADS1299 ---- */
    ret = ads1299_init(&sensor_cfg);
    if (ret < 0) {
        LOG_ERR("ADS1299 init failed: %d - system halted", ret);
        return;
    }
    LOG_INF("ADS1299 ready at 250 SPS");

    /* Start continuous conversion */
    ret = ads1299_start_continuous();
    if (ret < 0) {
        LOG_ERR("ADS1299 start continuous failed: %d", ret);
        return;
    }

    /* ---- Initialize DAC8562 ---- */
    ret = dac_init();
    if (ret < 0) {
        LOG_ERR("DAC init failed: %d - stim disabled", ret);
    } else {
        LOG_INF("DAC8562 ready, output 0mA");
    }

    /* ---- Initialize UART protocol to ESP32-S3 ---- */
    ret = uart_protocol_init();
    if (ret < 0) {
        LOG_ERR("UART protocol init failed: %d", ret);
        return;
    }
    uart_set_callback(on_uart_packet);
    LOG_INF("UART ready (115200 baud)");

    /* ---- Initialize BLE ---- */
    ret = ble_service_init();
    if (ret < 0) {
        LOG_ERR("BLE init failed: %d", ret);
        return;
    }
    ble_set_command_callback(on_ble_command);
    LOG_INF("BLE advertising as 'NeuroResonator'");

    /* ---- Initialize safety monitor ---- */
    ret = safety_init();
    if (ret < 0) {
        LOG_ERR("Safety init failed: %d", ret);
        return;
    }
    LOG_INF("Safety monitor initialized");

    /* ---- Create threads ---- */
    k_thread_create(&eeg_thread_data, eeg_stack,
                    K_THREAD_STACK_SIZEOF(eeg_stack),
                    eeg_thread, NULL, NULL, NULL,
                    5, 0, K_NO_WAIT);

    k_thread_create(&ble_thread_data, ble_stack,
                    K_THREAD_STACK_SIZEOF(ble_stack),
                    ble_thread, NULL, NULL, NULL,
                    3, 0, K_NO_WAIT);

    k_thread_create(&safety_thread_data, safety_stack,
                    K_THREAD_STACK_SIZEOF(safety_stack),
                    safety_thread, NULL, NULL, NULL,
                    4, 0, K_NO_WAIT);

    k_thread_create(&uart_rx_thread_data, uart_rx_stack,
                    K_THREAD_STACK_SIZEOF(uart_rx_stack),
                    uart_rx_thread, NULL, NULL, NULL,
                    2, 0, K_NO_WAIT);

    system_initialized = true;

    LOG_INF("=== NeuroResonator operational ===");

    /* Main loop: periodic 1Hz tasks and command dispatch */
    while (1) {
        /* Send EEG data to ESP32 every second */
        send_eeg_to_esp32();

        /* Sleep for 1 second */
        k_sleep(K_MSEC(BRAIN_STATE_INTERVAL_MS));
    }
}
```

## include/ads1299.h
```c
#ifndef NEURORESONATOR_ADS1299_H
#define NEURORESONATOR_ADS1299_H

#include <zephyr/types.h>
#include <stdbool.h>

#ifdef __cplusplus
extern "C" {
#endif

/* ADS1299 Register Map */
#define ADS1299_REG_ID          0x00
#define ADS1299_REG_CONFIG1     0x01
#define ADS1299_REG_CONFIG2     0x02
#define ADS1299_REG_CONFIG3     0x03
#define ADS1299_REG_LOFF        0x04
#define ADS1299_REG_CH1SET      0x05
#define ADS1299_REG_CH2SET      0x06
#define ADS1299_REG_CH3SET      0x07
#define ADS1299_REG_CH4SET      0x08
#define ADS1299_REG_CH5SET      0x09
#define ADS1299_REG_CH6SET      0x0A
#define ADS1299_REG_CH7SET      0x0B
#define ADS1299_REG_CH8SET      0x0C
#define ADS1299_REG_BIAS_SENSP  0x0D
#define ADS1299_REG_BIAS_SENSN  0x0E
#define ADS1299_REG_LOFF_SENSP  0x0F
#define ADS1299_REG_LOFF_SENSN  0x10
#define ADS1299_REG_LOFF_FLIP   0x11
#define ADS1299_REG_LOFF_STATP  0x12
#define ADS1299_REG_LOFF_STATN  0x13
#define ADS1299_REG_GPIO        0x14
#define ADS1299_REG_MISC1       0x15
#define ADS1299_REG_MISC2       0x16
#define ADS1299_REG_CONFIG4     0x17

/* CONFIG1 register bits */
#define ADS1299_CONFIG1_DAISY_EN    (1 << 7)
#define ADS1299_CONFIG1_CLK_EN      (1 << 6)
#define ADS1299_CONFIG1_DR_MASK     0x07
#define ADS1299_CONFIG1_DR_250SPS   0x06
#define ADS1299_CONFIG1_DR_500SPS   0x05
#define ADS1299_CONFIG1_DR_1000SPS  0x04
#define ADS1299_CONFIG1_DR_2000SPS  0x03
#define ADS1299_CONFIG1_DR_4000SPS  0x02
#define ADS1299_CONFIG1_DR_8000SPS  0x01
#define ADS1299_CONFIG1_DR_16000SPS 0x00

/* CONFIG2 register bits */
#define ADS1299_CONFIG2_WCT_CHOP    (1 << 7)
#define ADS1299_CONFIG2_INT_TEST    (1 << 5)
#define ADS1299_CONFIG2_TEST_FREQ   (1 << 4)
#define ADS1299_CONFIG2_TEST_SIG_MASK 0x0C
#define ADS1299_CONFIG2_TEST_SIG_1HZ  0x00

/* CONFIG3 register bits */
#define ADS1299_CONFIG3_PDB_REFBUF  (1 << 7)
#define ADS1299_CONFIG3_VREF_4V     (1 << 6)
#define ADS1299_CONFIG3_BIAS_MEAS   (1 << 5)
#define ADS1299_CONFIG3_BIAS_REFBUF (1 << 4)
#define ADS1299_CONFIG3_BIAS_MVDD   (1 << 3)
#define ADS1299_CONFIG3_BIAS_SENS   (1 << 2)
#define ADS1299_CONFIG3_BIAS_STAT   (1 << 1)
#define ADS1299_CONFIG3_PDB_BIAS    (1 << 0)

/* LOFF register bits */
#define ADS1299_LOFF_COMPLEN        0x07
#define ADS1299_LOFF_VLEADOFF_MASK  0x18
#define ADS1299_LOFF_VLEADOFF_OFF   (0 << 3)
#define ADS1299_LOFF_VLEADOFF_6nA   (2 << 3)
#define ADS1299_LOFF_VLEADOFF_24nA  (3 << 3)
#define ADS1299_LOFF_VLEADOFF_6uA   (7 << 3)
#define ADS1299_LOFF_FLEADOFF_MASK  0x60
#define ADS1299_LOFF_FLEADOFF_DC    (0 << 5)
#define ADS1299_LOFF_FLEADOFF_AC    (1 << 5)

/* CHnSET register bits */
#define ADS1299_CHnSET_PD           (1 << 7)
#define ADS1299_CHnSET_GAIN_MASK    0x70
#define ADS1299_CHnSET_GAIN_1       (0 << 4)
#define ADS1299_CHnSET_GAIN_2       (1 << 4)
#define ADS1299_CHnSET_GAIN_3       (2 << 4)
#define ADS1299_CHnSET_GAIN_4       (3 << 4)
#define ADS1299_CHnSET_GAIN_6       (4 << 4)
#define ADS1299_CHnSET_GAIN_8       (5 << 4)
#define ADS1299_CHnSET_GAIN_12      (6 << 4)
#define ADS1299_CHnSET_GAIN_24      (7 << 4)
#define ADS1299_CHnSET_SRB2         (1 << 3)
#define ADS1299_CHnSET_MUX_MASK     0x07
#define ADS1299_CHnSET_MUX_NORMAL   0x00
#define ADS1299_CHnSET_MUX_SHORTED  0x01
#define ADS1299_CHnSET_MUX_BIAS_MEAS 0x02
#define ADS1299_CHnSET_MUX_MVDD     0x03
#define ADS1299_CHnSET_MUX_TEMP     0x04
#define ADS1299_CHnSET_MUX_TEST     0x05
#define ADS1299_CHnSET_MUX_BIAS_DRP 0x06
#define ADS1299_CHnSET_MUX_BIAS_DRN 0x07

/* SPI commands */
#define ADS1299_CMD_WAKEUP    0x02
#define ADS1299_CMD_STANDBY   0x04
#define ADS1299_CMD_RESET     0x06
#define ADS1299_CMD_START     0x08
#define ADS1299_CMD_STOP      0x0A
#define ADS1299_CMD_OFFSETCAL 0x1A
#define ADS1299_CMD_RDATAC    0x10
#define ADS1299_CMD_SDATAC    0x11
#define ADS1299_CMD_RDATA     0x12
#define ADS1299_CMD_RREG      0x20
#define ADS1299_CMD_WREG      0x40

/* Number of channels */
#define ADS1299_NUM_CHANNELS 4

/* ADC full-scale range */
#define ADS1299_VREF         4.5f
#define ADS1299_GAIN         24.0f
#define ADS1299_LSB_SIZE     (ADS1299_VREF / (ADS1299_GAIN * 16777216.0f * 0.5f))

/* Configuration structure */
struct ads1299_config {
    uint8_t num_channels;
    uint8_t gain[8];
    uint8_t channel_mux[8];
    uint8_t sampling_rate;
    bool srb1_enabled;
    bool bias_enabled;
    bool lead_off_enabled;
};

/* 24-bit EEG data per channel */
struct ads1299_sample {
    int32_t channels[ADS1299_NUM_CHANNELS];
    uint32_t timestamp;
};

/* Driver API */
int ads1299_init(const struct ads1299_config *cfg);
int ads1299_read_register(uint8_t reg, uint8_t *value);
int ads1299_write_register(uint8_t reg, uint8_t value);
int ads1299_start_continuous(void);
int ads1299_stop(void);
int ads1299_read_data(struct ads1299_sample *sample);
int ads1299_perform_offset_cal(void);
int ads1299_reset(void);
int ads1299_self_test(void);
float ads1299_convert_to_voltage(int32_t raw_code);

#ifdef __cplusplus
}
#endif

#endif /* NEURORESONATOR_ADS1299_H */
```

## include/ble_service.h
```c
#ifndef NEURORESONATOR_BLE_SERVICE_H
#define NEURORESONATOR_BLE_SERVICE_H

#include <zephyr/types.h>
#include <stdbool.h>
#include <stdint.h>

#ifdef __cplusplus
extern "C" {
#endif

/* Custom service UUID: B9580000-6E82-4B8A-BF9C-7A9B1B0F1C3D */
/* Brain state characteristic UUID: B9580001-6E82-4B8A-BF9C-7A9B1B0F1C3D */
/* Command characteristic UUID:     B9580002-6E82-4B8A-BF9C-7A9B1B0F1C3D */
/* Battery characteristic UUID:     B9580003-6E82-4B8A-BF9C-7A9B1B0F1C3D */

#define BRAIN_STATE_UUID_VAL \
    BT_UUID_128_ENCODE(0xB9580001, 0x6E82, 0x4B8A, 0xBF9C, 0x7A9B1B0F1C3D)
#define COMMAND_UUID_VAL \
    BT_UUID_128_ENCODE(0xB9580002, 0x6E82, 0x4B8A, 0xBF9C, 0x7A9B1B0F1C3D)
#define BATTERY_UUID_VAL \
    BT_UUID_128_ENCODE(0xB9580003, 0x6E82, 0x4B8A, 0xBF9C, 0x7A9B1B0F1C3D)
#define SERVICE_UUID_VAL \
    BT_UUID_128_ENCODE(0xB9580000, 0x6E82, 0x4B8A, 0xBF9C, 0x7A9B1B0F1C3D)

/* Brain state notification payload (20 bytes) */
struct brain_state_payload {
    uint8_t channel_data[8];    /* 4 channels × 2 bytes (compressed) */
    uint8_t alpha_power;        /* Alpha band power scaled 0-255 */
    uint8_t beta_power;         /* Beta band power scaled 0-255 */
    uint8_t theta_power;        /* Theta band power scaled 0-255 */
    uint8_t delta_power;        /* Delta band power scaled 0-255 */
    uint8_t focus_score;        /* 0-100 focus score */
    uint8_t current_ma_x10;     /* tDCS current in 0.1mA units */
    uint8_t status_flags;       /* Bit 0: stim_active, Bit 1: safety_ok */
    uint8_t reserved[3];
} __attribute__((packed));

/* Command payload from phone (4 bytes) */
struct command_payload {
    uint8_t cmd_id;
    uint8_t param1;
    uint8_t param2;
    uint8_t param3;
} __attribute__((packed));

/* Command IDs */
#define CMD_ID_START_STIM     0x01
#define CMD_ID_STOP_STIM      0x02
#define CMD_ID_SET_CURRENT    0x03
#define CMD_ID_SET_MODE       0x04
#define CMD_ID_CALIBRATE      0x05
#define CMD_ID_GET_STATUS     0x06

/* Command callback type */
typedef void (*ble_command_callback_t)(const struct command_payload *cmd);

/* API */
int ble_service_init(void);
int ble_notify_brain_state(const struct brain_state_payload *state);
int ble_update_battery_level(uint8_t level_percent);
void ble_set_command_callback(ble_command_callback_t cb);
bool ble_is_connected(void);

#ifdef __cplusplus
}
#endif

#endif /* NEURORESONATOR_BLE_SERVICE_H */
```

## include/dac_control.h
```c
#ifndef NEURORESONATOR_DAC_CONTROL_H
#define NEURORESONATOR_DAC_CONTROL_H

#include <zephyr/types.h>
#include <stdbool.h>

#ifdef __cplusplus
extern "C" {
#endif

/* DAC8562 voltage reference */
#define DAC8562_VREF          2.5f
#define DAC8562_RESOLUTION    65535.0f

/* Current range: ±2mA through 2.5kΩ load with differential output */
/* I_out = (Vout - Vref) / R_load */
/* For ±2mA: Vout ranges from Vref-5V to Vref+5V */
/* DAC equation: dac_code = (desired_current_ma / CURRENT_RANGE_MA) * DAC_RESOLUTION */

#define DAC_CURRENT_RANGE_MA  2.0f
#define DAC_LOAD_RESISTOR     2500.0f   /* 2.5kΩ */
#define DAC_RAMP_RATE_MAX     0.5f      /* mA/s max ramp rate */
#define DAC_RAMP_INTERVAL_MS  50        /* Update interval for ramping */

/* DAC8562 commands */
#define DAC_CMD_WRITE_INPUT_N     0x00  /* Write to input register N */
#define DAC_CMD_UPDATE_DAC_N      0x10  /* Update DAC register N */
#define DAC_CMD_WRITE_UPDATE_N    0x20  /* Write to input N, update all */
#define DAC_CMD_WRITE_UPDATE_BC   0x30  /* Write to input N, update broadcast */
#define DAC_CMD_POWER_UP_DOWN     0x40
#define DAC_CMD_RESET             0x50
#define DAC_CMD_LDAC_REG          0x60
#define DAC_CMD_INTERNAL_REF      0x70

/* DAC channels */
#define DAC_CHANNEL_A  0
#define DAC_CHANNEL_B  1

/* DAC code calculation */
#define DAC_CURRENT_TO_CODE(ma) \
    (uint16_t)(((float)(ma) / DAC_CURRENT_RANGE_MA) * 32768.0f + 32768.0f)

#define DAC_CODE_TO_CURRENT(code) \
    (((float)(code) - 32768.0f) / 32768.0f * DAC_CURRENT_RANGE_MA)

/* API */
int dac_init(void);
int dac_set_current_ma(float current_ma);
int dac_set_channel_ma(uint8_t channel, float current_ma);
int dac_ramp_up(float target_ma, float ramp_rate);
int dac_ramp_down(float ramp_rate);
int dac_shutdown(void);
int dac_set_internal_ref(bool enable);
float dac_get_current_ma(void);

#ifdef __cplusplus
}
#endif

#endif /* NEURORESONATOR_DAC_CONTROL_H */
```

## include/tdcs_safety.h
```c
#ifndef NEURORESONATOR_TDCS_SAFETY_H
#define NEURORESONATOR_TDCS_SAFETY_H

#include <zephyr/types.h>
#include <stdbool.h>

#ifdef __cplusplus
extern "C" {
#endif

/* Safety limits */
#define MAX_CURRENT_MA          2.0f    /* Maximum stimulation current */
#define MAX_SESSION_MIN         40      /* Maximum session duration in minutes */
#define MAX_IMPEDANCE_KOHM      20      /* Maximum electrode impedance */
#define SESSION_WARN_MIN        35      /* Warning at 35 minutes */
#define RAMP_RATE               0.5f    /* Safe ramp rate mA/s */
#define IMPEDANCE_MEAS_CURRENT  0.0001f /* 100nA test current */
#define IMPEDANCE_MEAS_FREQ     100     /* 100Hz test frequency */
#define IMPEDANCE_MAX_VOLTAGE   2.0f    /* Max voltage for 100nA through 20kΩ */

/* Safety error states */
enum safety_error {
    SAFETY_OK = 0,
    ERR_HIGH_IMPEDANCE,
    ERR_OVERCURRENT,
    ERR_SESSION_TIMEOUT,
    ERR_ABORT
};

/* Safety state structure */
struct safety_state {
    enum safety_error last_error;
    float current_current_ma;
    float measured_impedance_kohm;
    uint32_t session_elapsed_sec;
    uint32_t session_start_ticks;
    bool stim_active;
    bool safe_stop_asserted;
    bool impedance_ok;
    bool overcurrent_ok;
    bool session_time_ok;
};

/* API */
int safety_init(void);
int safety_check(float current_ma, float impedance_kohm);
bool safety_ok(void);
enum safety_error safety_get_error(void);
int safety_tick(void);
int safety_start_session(void);
int safety_stop_session(void);
int safety_measure_impedance(float *impedance_kohm);
int safety_emergency_stop(void);
void safety_reset_error(void);
void safety_get_state(struct safety_state *state);

#ifdef __cplusplus
}
#endif

#endif /* NEURORESONATOR_TDCS_SAFETY_H */
```

## include/uart_protocol.h
```c
#ifndef NEURORESONATOR_UART_PROTOCOL_H
#define NEURORESONATOR_UART_PROTOCOL_H

#include <zephyr/types.h>
#include <stdbool.h>
#include <stdint.h>

#ifdef __cplusplus
extern "C" {
#endif

/* UART configuration */
#define UART_BAUDRATE    115200
#define UART_DATA_BITS   8
#define UART_PARITY      NRF_UART_PARITY_EXCLUDED
#define UART_STOP_BITS   1

/* Protocol constants */
#define UART_SYNC_BYTE        0xAA
#define UART_MAX_PAYLOAD_SIZE 256
#define UART_RING_BUF_SIZE    512

/* Packet types */
#define PKT_TYPE_EEG_DATA     0x01   /* nRF → ESP: 4ch × 24bit EEG */
#define PKT_TYPE_FOCUS_STATE  0x02   /* ESP → nRF: focus state update */
#define PKT_TYPE_LOG          0x03   /* Bidirectional: log messages */
#define PKT_TYPE_COMMAND      0x04   /* nRF → ESP: system command */
#define PKT_TYPE_ACK          0x05   /* Bidirectional: acknowledgment */
#define PKT_TYPE_ERROR        0x06   /* Bidirectional: error report */

/* EEG data packet payload (12 bytes: 4 channels × 24-bit) */
struct __attribute__((packed)) eeg_data_payload {
    uint8_t channel_0[3];    /* 24-bit twos complement, MSB first */
    uint8_t channel_1[3];
    uint8_t channel_2[3];
    uint8_t channel_3[3];
    uint32_t seq_num;        /* Sequence number to detect drops */
    uint32_t timestamp_ms;   /* Local timestamp */
};

/* Focus state payload from ESP32-S3 */
struct __attribute__((packed)) focus_state_payload {
    uint8_t  state;          /* Focus state enum */
    uint8_t  score;          /* 0-100 focus score */
    uint8_t  current_ma_x10; /* Recommended current in 0.1mA */
    uint8_t  mode;           /* Stimulation mode */
    uint8_t  reserved[4];    /* Future use */
};

/* Focus state enums */
#define FOCUS_STATE_DEEP     0x03
#define FOCUS_STATE_MODERATE 0x02
#define FOCUS_STATE_LIGHT    0x01
#define FOCUS_STATE_NONE     0x00
#define FOCUS_STATE_ERROR    0xFF

/* Stimulation modes */
#define STIM_MODE_OFF        0x00
#define STIM_MODE_CONTINUOUS 0x01
#define STIM_MODE_PULSED     0x02
#define STIM_MODE_ALPHA_SYNC 0x03

/* Generic packet header */
struct __attribute__((packed)) uart_packet {
    uint8_t  sync_byte;      /* 0xAA */
    uint8_t  type;           /* Packet type */
    uint16_t length;         /* Payload length (big-endian) */
    uint8_t  payload[UART_MAX_PAYLOAD_SIZE]; /* Variable payload */
    uint8_t  crc;            /* CRC8 of type + length + payload */
};

/* Parser state machine states */
enum uart_parser_state {
    UART_WAIT_SYNC = 0,
    UART_WAIT_TYPE,
    UART_WAIT_LENGTH_H,
    UART_WAIT_LENGTH_L,
    UART_WAIT_PAYLOAD,
    UART_WAIT_CRC
};

/* Parser context */
struct uart_parser {
    enum uart_parser_state state;
    uint8_t  type;
    uint16_t length;
    uint16_t payload_index;
    uint8_t  payload[UART_MAX_PAYLOAD_SIZE];
    uint8_t  expected_crc;
    uint8_t  computed_crc;
};

/* Packet receive callback type */
typedef void (*uart_packet_callback_t)(uint8_t type, const uint8_t *payload, uint16_t length);

/* Transmit context for async sending */
struct uart_tx_buf {
    uint8_t data[UART_RING_BUF_SIZE];
    uint16_t head;
    uint16_t tail;
};

/* API */
int uart_protocol_init(void);
int uart_send_packet(uint8_t type, const uint8_t *payload, uint16_t length);
int uart_send_eeg_data(const struct eeg_data_payload *eeg);
int uart_send_log(const char *log_str);
int uart_process(void);
void uart_set_callback(uart_packet_callback_t cb);
bool uart_is_tx_idle(void);
uint8_t uart_crc8_dallas(const uint8_t *data, uint16_t len);

#ifdef __cplusplus
}
#endif

#endif /* NEURORESONATOR_UART_PROTOCOL_H */
```

## src/ads1299.c
```c
#include <zephyr/kernel.h>
#include <zephyr/device.h>
#include <zephyr/drivers/spi.h>
#include <zephyr/drivers/gpio.h>
#include <zephyr/logging/log.h>
#include <zephyr/sys/byteorder.h>
#include <string.h>
#include "ads1299.h"

LOG_MODULE_REGISTER(ads1299, LOG_LEVEL_DBG);

/* SPI device and configuration */
static const struct device *ads1299_spi;
static struct spi_config spi_cfg;
static struct spi_buf_set tx_buf_set;
static struct spi_buf_set rx_buf_set;

/* GPIO for DRDY, CS, RESET, PWDN, START */
static const struct device *gpio_dev;
static struct gpio_callback drdy_callback;

#define SPI_DEV_NODE    DT_NODELABEL(spi3)
#define GPIO_DEV_NODE   DT_NODELABEL(gpio0)

#define PIN_CS          5
#define PIN_DRDY        6
#define PIN_RESET       7
#define PIN_START       8
#define PIN_PWDN        9

static struct k_sem data_ready_sem;
static volatile bool drdy_asserted;
static bool continuous_mode;
static uint8_t num_channels;
static float channel_gain[8];

/* Forward static declarations */
static int spi_write_read(const uint8_t *tx_data, uint8_t *rx_data, uint16_t len);
static int spi_write(const uint8_t *data, uint16_t len);

static void drdy_isr(const struct device *dev, struct gpio_callback *cb, uint32_t pins)
{
    ARG_UNUSED(dev);
    ARG_UNUSED(cb);
    ARG_UNUSED(pins);
    drdy_asserted = true;
    k_sem_give(&data_ready_sem);
}

static int gpio_setup(void)
{
    int ret;

    gpio_dev = DEVICE_DT_GET(GPIO_DEV_NODE);
    if (!device_is_ready(gpio_dev)) {
        LOG_ERR("GPIO device not ready");
        return -ENODEV;
    }

    /* Configure CS as output, initially high */
    ret = gpio_pin_configure(gpio_dev, PIN_CS, GPIO_OUTPUT_ACTIVE);
    if (ret < 0) return ret;
    gpio_pin_set(gpio_dev, PIN_CS, 1);

    /* DRDY as input with interrupt */
    ret = gpio_pin_configure(gpio_dev, PIN_DRDY, GPIO_INPUT | GPIO_PULL_UP);
    if (ret < 0) return ret;
    ret = gpio_pin_interrupt_configure(gpio_dev, PIN_DRDY, GPIO_INT_EDGE_FALLING);
    if (ret < 0) return ret;
    gpio_init_callback(&drdy_callback, drdy_isr, BIT(PIN_DRDY));
    ret = gpio_add_callback(gpio_dev, &drdy_callback);
    if (ret < 0) return ret;

    /* RESET as output, high */
    ret = gpio_pin_configure(gpio_dev, PIN_RESET, GPIO_OUTPUT_ACTIVE);
    if (ret < 0) return ret;
    gpio_pin_set(gpio_dev, PIN_RESET, 1);

    /* START as output, low */
    ret = gpio_pin_configure(gpio_dev, PIN_START, GPIO_OUTPUT_INACTIVE);
    if (ret < 0) return ret;

    /* PWDN as output, high (not in power-down) */
    ret = gpio_pin_configure(gpio_dev, PIN_PWDN, GPIO_OUTPUT_ACTIVE);
    if (ret < 0) return ret;

    LOG_DBG("GPIO setup complete");
    return 0;
}

static int spi_setup(void)
{
    ads1299_spi = DEVICE_DT_GET(SPI_DEV_NODE);
    if (!device_is_ready(ads1299_spi)) {
        LOG_ERR("SPI device not ready");
        return -ENODEV;
    }

    spi_cfg.frequency = 4000000;
    spi_cfg.operation = SPI_OP_MODE_MASTER | SPI_WORD_SET(8) | SPI_TRANSFER_MSB |
                        SPI_MODE_CPHA | SPI_MODE_CPOL;
    spi_cfg.slave = 0;
    spi_cfg.cs = NULL;

    LOG_DBG("SPI setup complete at 4MHz");
    return 0;
}

static void spi_cs_select(void)
{
    gpio_pin_set(gpio_dev, PIN_CS, 0);
    k_busy_wait(1);
}

static void spi_cs_deselect(void)
{
    k_busy_wait(1);
    gpio_pin_set(gpio_dev, PIN_CS, 1);
}

static int spi_write_read(const uint8_t *tx_data, uint8_t *rx_data, uint16_t len)
{
    int ret;
    struct spi_buf tx_buf = { .buf = (void *)tx_data, .len = len };
    struct spi_buf rx_buf = { .buf = (void *)rx_data, .len = len };

    tx_buf_set.buffers = &tx_buf;
    tx_buf_set.count = 1;
    rx_buf_set.buffers = &rx_buf;
    rx_buf_set.count = 1;

    spi_cs_select();
    ret = spi_transceive(ads1299_spi, &spi_cfg, &tx_buf_set, &rx_buf_set);
    spi_cs_deselect();

    return ret;
}

static int spi_write(const uint8_t *data, uint16_t len)
{
    return spi_write_read(data, NULL, len);
}

int ads1299_read_register(uint8_t reg, uint8_t *value)
{
    uint8_t tx[3];
    uint8_t rx[3];
    int ret;

    tx[0] = ADS1299_CMD_RREG | reg;
    tx[1] = 0x00;
    tx[2] = 0x00;

    ret = spi_write_read(tx, rx, 3);
    if (ret < 0) {
        LOG_ERR("Failed to read register 0x%02X", reg);
        return ret;
    }

    *value = rx[2];
    return 0;
}

int ads1299_write_register(uint8_t reg, uint8_t value)
{
    uint8_t tx[3];
    uint8_t rx[3];
    int ret;

    tx[0] = ADS1299_CMD_WREG | reg;
    tx[1] = 0x00;
    tx[2] = value;

    ret = spi_write_read(tx, rx, 3);
    if (ret < 0) {
        LOG_ERR("Failed to write register 0x%02X = 0x%02X", reg, value);
        return ret;
    }

    LOG_DBG("Reg 0x%02X = 0x%02X", reg, value);
    return 0;
}

static int ads1299_send_command(uint8_t cmd)
{
    return spi_write(&cmd, 1);
}

int ads1299_reset(void)
{
    int ret;

    /* Toggle RESET pin low for at least 2μs */
    ret = gpio_pin_set(gpio_dev, PIN_RESET, 0);
    if (ret < 0) return ret;
    k_busy_wait(10);
    ret = gpio_pin_set(gpio_dev, PIN_RESET, 1);
    if (ret < 0) return ret;

    /* Wait for reset recovery: tPOR = 2^18 / fCLK ≈ 2.1ms at 4MHz internal */
    k_sleep(K_MSEC(10));

    /* Send SDATAC to ensure we're in command mode */
    ret = ads1299_send_command(ADS1299_CMD_SDATAC);
    if (ret < 0) return ret;

    k_sleep(K_MSEC(1));
    LOG_DBG("ADS1299 reset complete");
    return 0;
}

int ads1299_init(const struct ads1299_config *cfg)
{
    int ret;
    uint8_t val;
    uint8_t id_reg;

    if (!cfg) {
        return -EINVAL;
    }

    k_sem_init(&data_ready_sem, 0, 1);
    drdy_asserted = false;
    continuous_mode = false;
    num_channels = cfg->num_channels > ADS1299_NUM_CHANNELS ?
                   ADS1299_NUM_CHANNELS : cfg->num_channels;

    memcpy(channel_gain, cfg->gain, sizeof(channel_gain));

    ret = gpio_setup();
    if (ret < 0) return ret;

    ret = spi_setup();
    if (ret < 0) return ret;

    /* Power-up sequence */
    gpio_pin_set(gpio_dev, PIN_PWDN, 1);
    k_sleep(K_MSEC(10));

    ret = ads1299_reset();
    if (ret < 0) return ret;

    /* Verify device ID */
    ret = ads1299_read_register(ADS1299_REG_ID, &id_reg);
    if (ret < 0) return ret;
    LOG_DBG("ADS1299 ID: 0x%02X", id_reg);

    /* Check ID: bits 7-3 contain device ID, should be 0b10010 for ADS1299 */
    if ((id_reg & 0xF8) != 0x90) {
        LOG_ERR("Unexpected ADS1299 ID: 0x%02X", id_reg);
        return -ENODEV;
    }

    /* Configure CONFIG1: 250 SPS, internal oscillator */
    val = (cfg->sampling_rate & ADS1299_CONFIG1_DR_MASK) | ADS1299_CONFIG1_CLK_EN;
    ret = ads1299_write_register(ADS1299_REG_CONFIG1, val);
    if (ret < 0) return ret;

    /* Configure CONFIG2: internal test off, lead-off AC signal */
    val = ADS1299_CONFIG2_WCT_CHOP;
    ret = ads1299_write_register(ADS1299_REG_CONFIG2, val);
    if (ret < 0) return ret;

    /* Configure CONFIG3: enable bias, internal reference buffer */
    val = ADS1299_CONFIG3_PDB_REFBUF | ADS1299_CONFIG3_VREF_4V |
          ADS1299_CONFIG3_BIAS_REFBUF | ADS1299_CONFIG3_PDB_BIAS;
    if (cfg->bias_enabled) {
        val |= ADS1299_CONFIG3_BIAS_SENS;
    }
    ret = ads1299_write_register(ADS1299_REG_CONFIG3, val);
    if (ret < 0) return ret;

    /* Configure lead-off detection */
    if (cfg->lead_off_enabled) {
        val = ADS1299_LOFF_FLEADOFF_AC | ADS1299_LOFF_VLEADOFF_6nA;
        ret = ads1299_write_register(ADS1299_REG_LOFF, val);
        if (ret < 0) return ret;
    } else {
        ret = ads1299_write_register(ADS1299_REG_LOFF, 0x00);
        if (ret < 0) return ret;
    }

    /* Configure channel settings */
    for (int i = 0; i < ADS1299_NUM_CHANNELS; i++) {
        val = cfg->channel_mux[i] | cfg->gain[i];
        if (cfg->srb1_enabled) {
            val |= ADS1299_CHnSET_SRB2;
        }
        ret = ads1299_write_register(ADS1299_REG_CH1SET + i, val);
        if (ret < 0) return ret;
    }

    /* Configure SRB1 if enabled */
    if (cfg->srb1_enabled) {
        ret = ads1299_write_register(ADS1299_REG_MISC1, 0x20);
        if (ret < 0) return ret;
    }

    /* Wait for settling */
    k_sleep(K_MSEC(500));

    /* Perform offset calibration */
    ret = ads1299_perform_offset_cal();
    if (ret < 0) {
        LOG_WRN("Offset calibration failed, continuing");
    }

    LOG_INF("ADS1299 initialized: %d channels, %d SPS",
            num_channels, 250 / (1 << (cfg->sampling_rate & 0x07)));

    return 0;
}

int ads1299_start_continuous(void)
{
    int ret;

    /* Stop continuous mode first if active */
    if (continuous_mode) {
        ads1299_stop();
    }

    /* Ensure in command mode */
    ret = ads1299_send_command(ADS1299_CMD_SDATAC);
    if (ret < 0) return ret;
    k_sleep(K_MSEC(1));

    /* Start conversions */
    ret = gpio_pin_set(gpio_dev, PIN_START, 1);
    if (ret < 0) return ret;

    k_sleep(K_MSEC(5));

    /* Enter read-data continuous mode */
    ret = ads1299_send_command(ADS1299_CMD_RDATAC);
    if (ret < 0) return ret;

    continuous_mode = true;
    LOG_DBG("ADS1299 continuous mode started");
    return 0;
}

int ads1299_stop(void)
{
    int ret;

    /* Exit read-data continuous mode */
    if (continuous_mode) {
        ret = ads1299_send_command(ADS1299_CMD_SDATAC);
        if (ret < 0) return ret;
    }

    /* Stop conversions */
    ret = gpio_pin_set(gpio_dev, PIN_START, 0);
    if (ret < 0) return ret;

    ret = ads1299_send_command(ADS1299_CMD_STOP);
    if (ret < 0) return ret;

    continuous_mode = false;
    LOG_DBG("ADS1299 stopped");
    return 0;
}

int ads1299_read_data(struct ads1299_sample *sample)
{
    uint8_t tx_buf[27];
    uint8_t rx_buf[27];
    int ret;
    uint8_t num_bytes = 3 + num_channels * 3; /* Status word + 3 bytes per channel */

    if (!sample) {
        return -EINVAL;
    }

    /* Wait for DRDY with timeout */
    if (!drdy_asserted) {
        ret = k_sem_take(&data_ready_sem, K_MSEC(100));
        if (ret < 0) {
            LOG_WRN("DRDY timeout");
            return -ETIMEDOUT;
        }
    }
    drdy_asserted = false;

    /* Read data: in RDATAC mode, just shift out clocks to get data */
    memset(tx_buf, 0x00, sizeof(tx_buf));
    ret = spi_write_read(tx_buf, rx_buf, num_bytes);
    if (ret < 0) {
        LOG_ERR("SPI read failed: %d", ret);
        return ret;
    }

    /* Parse status word (first 3 bytes) - contains LOFF_STATP and LOFF_STATN */
    /* Unused in current implementation */

    /* Parse channel data: 24-bit twos complement, MSB first */
    for (int ch = 0; ch < num_channels; ch++) {
        int32_t raw = 0;
        uint8_t *ch_data = &rx_buf[3 + ch * 3];

        raw = (int32_t)((uint32_t)ch_data[0] << 16 |
                        (uint32_t)ch_data[1] << 8 |
                        (uint32_t)ch_data[2]);

        /* Sign-extend 24-bit to 32-bit */
        if (raw & 0x800000) {
            raw |= 0xFF000000;
        }

        sample->channels[ch] = raw;
    }

    sample->timestamp = k_cycle_get_32();

    return 0;
}

int ads1299_perform_offset_cal(void)
{
    int ret;

    /* Ensure we're not in RDATAC mode */
    if (continuous_mode) {
        ret = ads1299_send_command(ADS1299_CMD_SDATAC);
        if (ret < 0) return ret;
        k_sleep(K_MSEC(1));
    }

    /* Start conversions (need to be running for offset cal) */
    gpio_pin_set(gpio_dev, PIN_START, 1);
    k_sleep(K_MSEC(100));

    /* Send OFFSETCAL command */
    ret = ads1299_send_command(ADS1299_CMD_OFFSETCAL);
    if (ret < 0) return ret;

    /* Wait for calibration to complete (~8 * tDR = 32ms at 250SPS) */
    k_sleep(K_MSEC(100));

    gpio_pin_set(gpio_dev, PIN_START, 0);

    LOG_DBG("Offset calibration complete");
    return 0;
}

int ads1299_self_test(void)
{
    int ret;
    uint8_t val;

    /* Read ID register to verify SPI communication */
    ret = ads1299_read_register(ADS1299_REG_ID, &val);
    if (ret < 0) return ret;

    if ((val & 0xF8) != 0x90) {
        LOG_ERR("Self-test failed: bad ID 0x%02X", val);
        return -EIO;
    }

    /* Verify CONFIG1 can be written and read back */
    ret = ads1299_read_register(ADS1299_REG_CONFIG1, &val);
    if (ret < 0) return ret;

    ret = ads1299_write_register(ADS1299_REG_CONFIG1, val | 0x01);
    if (ret < 0) return ret;

    uint8_t check;
    ret = ads1299_read_register(ADS1299_REG_CONFIG1, &check);
    if (ret < 0) return ret;

    if ((check & 0x01) != (val & 0x01)) {
        LOG_ERR("Self-test failed: register write/read mismatch");
        return -EIO;
    }

    /* Restore */
    ret = ads1299_write_register(ADS1299_REG_CONFIG1, val);
    if (ret < 0) return ret;

    LOG_DBG("Self-test passed");
    return 0;
}

float ads1299_convert_to_voltage(int32_t raw_code)
{
    /* V = (raw_code * Vref) / (gain * 2^23) */
    float voltage = (float)raw_code * ADS1299_VREF;
    voltage /= (channel_gain[0] > 0 ? channel_gain[0] : 24.0f) * 8388608.0f;
    return voltage;
}
```
